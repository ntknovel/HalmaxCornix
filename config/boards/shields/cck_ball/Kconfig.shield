## config/boards/shields/cck_ball/Kconfig.shield
```kconfig
config SHIELD_CCK_BALL_LEFT
    def_bool $(shields_list_contains,cck_ball_left)

config SHIELD_CCK_BALL_RIGHT
    def_bool $(shields_list_contains,cck_ball_right)
```
