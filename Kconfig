## Kconfig
```kconfig
# SPDX-License-Identifier: MIT
rsource "modules/cck-steno/Kconfig"
config CCK_WHEEL_REMAP
    bool "CCK wheel routing through Studio-editable virtual slots"
    default n
    depends on DT_HAS_ZMK_BEHAVIOR_CCK_WHEEL_ENABLED
    depends on !ZMK_SPLIT || ZMK_SPLIT_ROLE_CENTRAL
config CCK_USB_AUTO_SELECT
    bool "CCK central chooses USB on a data connection"
    default n
    depends on ZMK_USB && ZMK_STUDIO
    depends on !ZMK_SPLIT || ZMK_SPLIT_ROLE_CENTRAL

config CCK_STENO_POINTER_ASSIST
    bool "CCK STENO A/I arrow anchors and EO mouse/trackball anchor"
    default n
    depends on CORNIX_STENO && ZMK_POINTING
    depends on !ZMK_SPLIT || ZMK_SPLIT_ROLE_CENTRAL
    depends on DT_HAS_NTK_CCK_STENO_SCROLL_ENABLED
```

## config/boards/shields/cck_ball/Kconfig.defconfig
```kconfig
if SHIELD_CCK_BALL_RIGHT

config ZMK_KEYBOARD_NAME
    default "WK CCK BALL"

config ZMK_SPLIT_ROLE_CENTRAL
    default y

endif

if SHIELD_CCK_BALL_LEFT || SHIELD_CCK_BALL_RIGHT

config ZMK_SPLIT
    default y

endif
```

## config/west.yml
```yaml
manifest:
  remotes:
    - name: zmkfirmware
      url-base: https://github.com/imhy123
    - name: DoctorWangWang
      url-base: https://github.com/DoctorWangWang
  projects:
    - name: zmk
      remote: zmkfirmware
      revision: v0.3-branch
      import: app/west.yml
    - name: zmk-pmw3610-driver
      remote: DoctorWangWang
      revision: main

  self:
    path: config
```

## dts/bindings/behaviors/zmk,behavior-cck-wheel.yaml
```yaml
description: Route a rotary pulse through one of four Studio-editable virtual slots
compatible: "zmk,behavior-cck-wheel"
include: one_param.yaml
```

## dts/bindings/behaviors/zmk,behavior-modu-steno-aux.yaml
```yaml
description: MODU physical spare key with STENO Symbol and Vowel-Extension selectors
compatible: "zmk,behavior-modu-steno-aux"
include: zero_param.yaml
properties:
  normal-key:
    type: int
    required: true
  symbol-key:
    type: int
    required: true
  function-key:
    type: int
    required: true
  function-layer:
    type: int
    required: true
  symbol-layer:
    type: int
    required: true
  one-shot-tab:
    type: boolean
```

## dts/bindings/input_processors/ntk,cck-steno-scroll.yaml
```yaml
description: CCK STENO EO held trackball scrolling with vowel consumption
compatible: "ntk,cck-steno-scroll"
include: base.yaml
properties:
  "#input-processor-cells":
    type: int
    required: true
    const: 0
  track-remainders:
    type: boolean
```
